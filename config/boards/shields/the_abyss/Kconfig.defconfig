## config/boards/shields/the_abyss/Kconfig.defconfig
```kconfig
if SHIELD_GOOGOOTKAH_LEFT

config ZMK_KEYBOARD_NAME
    default "Googootkah"

endif

if SHIELD_GOOGOOTKAH_RIGHT

config ZMK_KEYBOARD_NAME
    default "Googootkah"

endif
```

## config/west.yml
```yaml
manifest:
  remotes:
    - name: zmkfirmware
      url-base: https://github.com/zmkfirmware
    - name: petejohanson
      url-base: https://github.com/petejohanson
    - name: nguyendown
      url-base: https://github.com/nguyendown
  projects:
    - name: zmk
      remote: zmkfirmware
      revision: main
      import: app/west.yml
  self:
    path: config
```
