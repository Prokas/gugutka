## config/boards/shields/the_abyss/Kconfig.shield
```kconfig
config SHIELD_GOOGOOTKAH_LEFT
    def_bool $(shields_list_contains,googootkah_left)

config SHIELD_GOOGOOTKAH_RIGHT
    def_bool $(shields_list_contains,googootkah_right)
```
